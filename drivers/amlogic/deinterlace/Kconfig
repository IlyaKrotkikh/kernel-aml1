## drivers/amlogic/deinterlace/Kconfig
```kconfig
#
# Deinterlace driver configuration
#

menu "AMLOGIC Deinterlace driver"

config DEINTERLACE
    tristate "DEINTERLACE driver"
    depends on !MESON_SAVE_MEM
    default n
	help
	  Select to enable AMLOGIC DEINTERLACE driver.
endmenu
```

## drivers/amlogic/nand/Kconfig
```kconfig
#
# Amlogic NAND device configuration
#

menu "AMLOGIC NAND Flash support"

config AM_NAND
	bool "Amlogic NAND FLASH M1/M2/M3 SUPPORT"
	    depends on AMLOGIC_SERIES
	default y
        select MTD_NAND 
	    select MTD_PARTITIONS
        select MTD_BLOCK
        select MTD_CHAR
        help
		This is Meson_M1 nand suport

config AM_NAND_RBPIN
	bool "use nand rbpin (A3/M3 optional)"
	    depends on AM_NAND && !ARCH_MESON3


config AML_NAND_ENV
	bool "use aml nand env (/dev/nand_env)"
	    depends on AM_NAND
	default y
				
config AML_NFTL
	tristate "Amlogic NFTL (NAND Flash Translation Layer) support"
	depends on AM_NAND
	default y
        help
		This is aml nftl suport

config AML_EXPORT_FLASH
	tristate "Use direct particion for big nand"
	depends on AM_NAND && !AML_NFTL
	default y
endmenu
```

## drivers/amlogic/ppmgr/Kconfig
```kconfig
#
# Post Process Manager device configuration
#

menu "AMLOGIC Post Process Manager driver"

config POST_PROCESS_MANAGER
    tristate "AMLOGIC Post Process Manager driver"
    default y
	help
	  Select to enable AMLOGIC Post Process Manager driver.

config MIX_FREE_SCALE
    tristate "AMLOGIC mix free scale"
    depends on  POST_PROCESS_MANAGER
    default y
	help
	  Select mix free scale mode in  ppmgr module.
endmenu
```
